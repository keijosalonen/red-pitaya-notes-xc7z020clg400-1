/*
 * CAUTION: This file is automatically generated by Xilinx.
 * Version: XSCT 2023.1
 * Today is: Sun Aug 11 20:16:18 2024
 */


/dts-v1/;
/include/ "zynq-7000.dtsi"
/include/ "pcw.dtsi"
/ {
	chosen {
		bootargs = "console=ttyPS0,115200 earlyprintk earlycon";
		stdout-path = "serial0:115200n8";
	};
	aliases {
		ethernet0 = &gem0;
		i2c0 = &i2c0;
		serial0 = &uart0;
		serial1 = &uart1;
		spi0 = &spi0;
		spi1 = &spi1;
	};
	memory@0 {
		device_type = "memory";
		reg = <0x0 0x20000000>;
	};
};
